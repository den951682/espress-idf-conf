## main/Kconfig.projbuild
```kconfig
menu "Conf Configuration"
	menu "Bt server"
		config BT_SERVER_NAME
    		string "Bluetooth Name"
    		default "Conf server"
    		help
			Bluetooth name to connect to.
		config BT_SSP_IO_CAP
            int "SSP IO Capability (0=DisplayOnly,1=DisplayYesNo,2=KeyboardOnly,3=NoInputNoOutput)"
    		range 0 3
    		default 1
    	config BT_SPP_SECURE_MODE
            bool "Require authentication for SPP link"
            default y
	endmenu
	config PASSPHRASE
    		string "Pass phrase"
    		default "PiroJOKE"
    		help
			Default passphrase to use in Passphrase ciffer protocols.
	choice
        prompt "Default Protocol"
        default PROTOCOL_EPHEMERAL
        help
            Select which protocol to use by default:
            - Ephemeral AES
            - AES with Passphrase
            - Raw (no encryption)

        config PROTOCOL_EPHEMERAL
            bool "Ephemeral AES"

        config PROTOCOL_PASSPHRASE
            bool "AES with Passphrase"

        config PROTOCOL_RAW
            bool "Raw (no encryption)"
    endchoice
    
endmenu
```
